#include "lcd.h"

// 8x8 ASCII Pixmap
uint8_t font8x8_basic[128][8] = {
    { 0x00, 0x00, 0x00, 0x00, 0x00, 0x00, 0x00, 0x00},   // U+0000 (nul)
    { 0x00, 0x00, 0x00, 0x00, 0x00, 0x00, 0x00, 0x00},   // U+0001
    { 0x00, 0x00, 0x00, 0x00, 0x00, 0x00, 0x00, 0x00},   // U+0002
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    { 0x00, 0x00, 0x00, 0x00, 0x00, 0x00, 0x00, 0x00}    // U+007F
};

void lcd_transfer(uint8_t reg, uint8_t data){	
	// Enable the LCD with CS Low
	gpio_set(LCD_CS_PORT, LCD_CS_PIN, 0);
	
	// Select Data/Command Register with DS
	gpio_set(LCD_DS_PORT, LCD_DS_PIN, reg);
	
	#ifdef LCD_USE_HW_SPI
		SSI2_DR_R = data;
		while((SSI2_SR_R & 0x01) == 0);
	#else
		for(uint8_t mask = 0x80; mask; mask >>= 1){
			// Set MOSI according to the current bit in data
			gpio_set(LCD_MOSI_PORT, LCD_MOSI_PIN, (data & mask) !=0);
			
			// Clock the bit out
			gpio_set(LCD_SCK_PORT, LCD_SCK_PIN, 0);	
			gpio_set(LCD_SCK_PORT, LCD_SCK_PIN, 1);
		}
	#endif
	
	
	// Disable the LCD with CS High
	gpio_set(LCD_CS_PORT, LCD_CS_PIN, 1);
}

void lcd_transfer16(uint8_t reg, uint16_t data){
	
	// Enable the LCD with CS Low
	gpio_set(LCD_CS_PORT, LCD_CS_PIN, 0);
	
	// Select Data/Command Register with DS
	gpio_set(LCD_DS_PORT, LCD_DS_PIN, reg);

	#ifdef LCD_USE_HW_SPI
		//while((SSI2_SR_R & 0x01) == 0);
		SSI2_DR_R = (data >> 8);
		while((SSI2_SR_R & 0x01) == 0);
		gpio_set(LCD_CS_PORT, LCD_CS_PIN, 1);
		gpio_set(LCD_CS_PORT, LCD_CS_PIN, 0);
		SSI2_DR_R = data;
		while((SSI2_SR_R & 0x01) == 0);
		
	
	#else
		for(uint8_t mask = 0x80; mask; mask >>= 1){
			// Set MOSI according to the current bit in data
			gpio_set(LCD_MOSI_PORT, LCD_MOSI_PIN, ((data >> 8) & mask) !=0);
			
			// Clock the bit out
			gpio_set(LCD_SCK_PORT, LCD_SCK_PIN, 0);	
			gpio_set(LCD_SCK_PORT, LCD_SCK_PIN, 1);
		}
		gpio_set(LCD_CS_PORT, LCD_CS_PIN, 1);
		gpio_set(LCD_CS_PORT, LCD_CS_PIN, 0);
		for(uint8_t mask = 0x80; mask; mask >>= 1){
			// Set MOSI according to the current bit in data
			gpio_set(LCD_MOSI_PORT, LCD_MOSI_PIN, (data & mask) !=0);
			
			// Clock the bit out
			gpio_set(LCD_SCK_PORT, LCD_SCK_PIN, 0);	
			gpio_set(LCD_SCK_PORT, LCD_SCK_PIN, 1);
		}
	#endif
	
	
	// Disable the LCD with CS High
	gpio_set(LCD_CS_PORT, LCD_CS_PIN, 1);
}

void lcd_command(uint8_t command){
	// Transfer command
	lcd_transfer(0, command);
}

void lcd_data(uint8_t data){
	// Transfer data
	lcd_transfer(1, data);
}

void lcd_init(){
	// GPIO Setup
	gpio_init(LCD_SCK_PORT, LCD_SCK_PIN);
	#ifdef LCD_USE_HW_SPI
		gpio_mode(LCD_SCK_PORT, LCD_SCK_PIN, ALTERNATE);
		gpio_alternate(LCD_SCK_PORT, LCD_SCK_PIN, 2);
	#else
		gpio_mode(LCD_SCK_PORT, LCD_SCK_PIN, OUTPUT);
	#endif
	
	
	gpio_init(LCD_MOSI_PORT, LCD_MOSI_PIN);
	#ifdef LCD_USE_HW_SPI
	gpio_mode(LCD_MOSI_PORT, LCD_MOSI_PIN, ALTERNATE);
	gpio_alternate(LCD_MOSI_PORT, LCD_MOSI_PIN, 2);
	#else
		gpio_mode(LCD_MOSI_PORT, LCD_MOSI_PIN, OUTPUT);
	#endif
	
	gpio_init(LCD_CS_PORT, LCD_CS_PIN);
	gpio_mode(LCD_CS_PORT, LCD_CS_PIN, OUTPUT);
	
	gpio_init(LCD_RESET_PORT, LCD_RESET_PIN);
	gpio_mode(LCD_RESET_PORT, LCD_RESET_PIN, OUTPUT);
	
	gpio_init(LCD_DS_PORT, LCD_DS_PIN);
	gpio_mode(LCD_DS_PORT, LCD_DS_PIN, OUTPUT);
	
	
	// GPIO Default Pin States
	gpio_set(LCD_CS_PORT, LCD_CS_PIN, 1);
	gpio_set(LCD_DS_PORT, LCD_DS_PIN, 0);
	#ifndef LCD_USE_HW_SPI
		gpio_set(LCD_MOSI_PORT, LCD_MOSI_PIN, 0);
		gpio_set(LCD_SCK_PORT, LCD_SCK_PIN, 1);
	#endif
	
	
	#ifdef LCD_USE_HW_SPI
		SYSCTL_RCGCSSI_R |= 0x04;	// Enable SSI2 Clock gate
		
		//GPIO_PORTB_PUR_R |= (1<<4);	 // Pull up for clock (idle high)
		gpio_pullup(LCD_SCK_PORT, LCD_SCK_PIN, 1);
		
		SSI2_CR1_R = 0x00; // Disable SSI2
		SSI2_CR0_R = 0x07;	// 8 bit transfers
		SSI2_CC_R = 0x00;	// System Clock as Clock Source
		SSI2_CPSR_R = 0x02;	// Prescaler -> 2 -> SSI Clock = SysClk/2
		SSI2_CR0_R |= (1<<6);	// Clk Idle High
		SSI2_CR1_R = 0x02; // Enable SSI2
	#endif
	
	
	// LCD Power Reset
	gpio_set(LCD_RESET_PORT, LCD_RESET_PIN, 1);
	delay_ms(100);
	gpio_set(LCD_RESET_PORT, LCD_RESET_PIN, 0);
  delay_ms(50);
  gpio_set(LCD_RESET_PORT, LCD_RESET_PIN, 1);
  delay_ms(120);
		
	
	// Software Reset
	lcd_command(HX8353E_SWRESET);
  delay_ms(150);
	
	// Sleep-Out (Wakeup)
	lcd_command(HX8353E_SLPOUT);
  delay_ms(200);
	
	// Initialization Sequence
	lcd_command(HX8353E_FRMCTR1);//In normal mode(Full colors)
  lcd_data(0x02);//RTNB: set 1-line period
  lcd_data(0x35);//FPB:  front porch
  lcd_data(0x36);//BPB:  back porch
	
	lcd_command(HX8353E_GAMSET);
	lcd_data(0x04);
	
	lcd_command(HX8353E_SETPWCTR);
	lcd_data(0x0A);
	lcd_data(0x14);
	
	lcd_command(HX8353E_SETSTBA);
	lcd_data(0x0A);
	lcd_data(0x00);
	
	lcd_command(HX8353E_COLMOD);
	lcd_data(0x05);
	delay_ms(10);
	
	lcd_command(HX8353E_MADCTL);
	lcd_data(HX8353E_MADCTL_RGB);
	
	lcd_command(HX8353E_CASET);
	lcd_data(0x00);
	lcd_data(0x00);
	lcd_data(0x00);
	lcd_data(0x79);
	
	lcd_command(HX8353E_RASET);
	lcd_data(0x00);
	lcd_data(0x00);
	lcd_data(0x00);
	lcd_data(0x79);
	
	lcd_command(HX8353E_NORON);
	delay_ms(10);
	
	lcd_command(HX8353E_DISPON);
	delay_ms(120);
	
	lcd_command(HX8353E_RAMWR);
	
	lcd_command(HX8353E_MADCTL);
	lcd_data(HX8353E_MADCTL_MX | HX8353E_MADCTL_MY | HX8353E_MADCTL_RGB);
}

void lcd_window(uint8_t x, uint8_t y, uint8_t width, uint8_t height){
	// Specify Column Range
  lcd_command(HX8353E_CASET);   
  lcd_transfer16(1, 0x02 + x);     
  lcd_transfer16(1, 0x02 + x + width - 1);     	
 
	// Specify Row Range
  lcd_command(HX8353E_RASET); 
  lcd_transfer16(1, 0x03 + y); 
  lcd_transfer16(1, 0x03 + y + height - 1);  
 
	// Write
  lcd_command(HX8353E_RAMWR);
}

void lcd_fill(uint16_t color){	
	// Select the whole screen
	lcd_window(0, 0, 128, 128);

	// Set every pixel data for all 128x128 pixels (RGB565 format)
  for (int i = 0; i < (128 * 128); ++i){
		lcd_transfer16(1, color);
		//lcd_data(color >> 8); // RGB565 Upper
		//lcd_data(color); // RGB565 Lower
  }
}

void lcd_pixel(uint8_t x, uint8_t y, uint16_t color){
	// Bounds check
	if(x > 127 || y > 127)
		return;
	
	// Select a single pixel
	lcd_window(x, y, 1, 1);
	
	// Set pixel color value (RGB565 format)
	lcd_transfer16(1, color);
	//lcd_data(color >> 8); // RGB565 Upper
	//lcd_data(color); 	// RGB565 Lower
}

void lcd_line(uint8_t x0, uint8_t y0, uint8_t x1, uint8_t y1, uint16_t color){
	uint8_t xmin, ymin, xmax, ymax;
	
	xmin = x0 < x1 ? x0 : x1;
	ymin = y0 < y1 ? y0 : y1;
	xmax = x0 < x1 ? x1 : x0;
	ymax = y0 < y1 ? y1 : y0;
	
	float m = ((float)(ymax - ymin)) / ((float)(xmax - xmin));
	
	float y = ymin;
	for(int x = xmin; x <= xmax; ++x){
		lcd_pixel(x, (int)y, color);
		y += m;
	}
}

void lcd_dashed_line(uint8_t x0, uint8_t y0, uint8_t x1, uint8_t y1, uint8_t len_line, uint16_t color)
{
	uint8_t xmin, ymin, xmax, ymax;
	
	xmin = x0 < x1 ? x0 : x1;
	ymin = y0 < y1 ? y0 : y1;
	xmax = x0 < x1 ? x1 : x0;
	ymax = y0 < y1 ? y1 : y0;

		uint8_t len = 0;
		uint16_t c = color;
	
	if(xmax==xmin)
	{
		for (int y = ymin; y<= ymax; ++y)
		{
			if(len==len_line)
			{
				len=0;
				c = (c==color ?  c = RGB565(0,0,0) : color);
			}
			lcd_pixel(xmax, y, c);
			len++;
		}
	}
	else
	{
		float m = ((float)(ymax - ymin)) / ((float)(xmax - xmin));

		float y = ymin;
		for(int x = xmin; x <= xmax; ++x)
		{
			if(len==len_line)
			{
				len=0;
				c = (c==color ?  c = RGB565(0,0,0) : color);
			}
			lcd_pixel(x, (int)y, c);
			y += m;
			len++;
		}
	}
}


void lcd_rectangle(uint8_t x0, uint8_t y0, uint8_t x1, uint8_t y1, uint16_t color){
	uint8_t xmin, ymin, xmax, ymax;
	
	xmin = x0 < x1 ? x0 : x1;
	ymin = y0 < y1 ? y0 : y1;
	xmax = x0 < x1 ? x1 : x0;
	ymax = y0 < y1 ? y1 : y0;
	
	lcd_line(xmin, ymin, xmax, ymin, color);
	lcd_line(xmin, ymin, xmin, ymax, color);
	lcd_line(xmax, ymin, xmax, ymax, color);
	lcd_line(xmin, ymax, xmax, ymax, color);
}

void lcd_rectangle_fill(uint8_t x0, uint8_t y0, uint8_t x1, uint8_t y1, uint16_t color){
	uint8_t xmin, ymin, xmax, ymax;
	
	xmin = x0 < x1 ? x0 : x1;
	ymin = y0 < y1 ? y0 : y1;
	xmax = x0 < x1 ? x1 : x0;
	ymax = y0 < y1 ? y1 : y0;
	
	lcd_window(xmin, ymin, xmax-xmin, ymax-ymin);
	
	for(int i = 0; i < ((xmax-xmin)*(ymax-ymin)); ++i){
		lcd_transfer16(1, color);
		//lcd_data(color >> 8); // RGB565 Upper
		//lcd_data(color); // RGB565 Lower
	}
}

void lcd_circle(uint8_t x0, uint8_t y0, uint8_t radius, uint16_t color){
	uint8_t x = radius;
  uint8_t y = 0;
  int16_t radiusError = 1 - (int16_t) x;

  while (x >= y){
    lcd_pixel(x0 - y, y0 + x, color);
    lcd_pixel(x0 + y, y0 + x, color);
    lcd_pixel(x0 - x, y0 + y, color);
    lcd_pixel(x0 + x, y0 + y, color);
    lcd_pixel(x0 - x, y0 - y, color);
    lcd_pixel(x0 + x, y0 - y, color);
    lcd_pixel(x0 - y, y0 - x, color);
    lcd_pixel(x0 + y, y0 - x, color);

    y++;
    if (radiusError < 0)
      radiusError += (int16_t)(2 * y + 1);
    else{
      x--;
      radiusError += 2 * (((int16_t) y - (int16_t) x) + 1);
    }
  }
}

void lcd_circle_fill(uint8_t x0, uint8_t y0, uint8_t radius, uint16_t color){
	uint8_t x = radius;
  uint8_t y = 0;
  int16_t radiusError = 1 - (int16_t) x;

  while (x >= y){
		//lcd_line(x0 - y, y0 + x, x0 + y, y0 + x, r, g, b);
		lcd_window(x0 - y, y0 + x, 2*y, 1);
		for(int i = 0; i <= 2*y; i++){
			lcd_transfer16(1, color);
			//lcd_data(color >> 8); // RGB565 Upper
			//lcd_data(color); // RGB565 Lower
		}
		
		//lcd_line(x0 - y, y0 - x, x0 + y, y0 - x, r, g, b);
		lcd_window(x0 - y, y0 - x, 2*y, 1);
		for(int i = 0; i <= 2*y; i++){
			lcd_transfer16(1, color);
			//lcd_data(color >> 8); // RGB565 Upper
			//lcd_data(color); // RGB565 Lower
		}
		
		
		//lcd_line(x0 - x, y0 + y, x0 + x, y0 + y, r, g, b);
		lcd_window(x0 - x, y0 + y, 2*x, 1);
		for(int i = 0; i < 2*x; i++){
			lcd_transfer16(1, color);
			//lcd_data(color >> 8); // RGB565 Upper
			//lcd_data(color); // RGB565 Lower
		}
		
		//lcd_line(x0 - x, y0 - y, x0 + x, y0 - y, r, g, b);
		lcd_window(x0 - x, y0 - y, 2*x, 1);
		for(int i = 0; i < 2*x; i++){
			lcd_transfer16(1, color);
			//lcd_data(color >> 8); // RGB565 Upper
			//lcd_data(color); // RGB565 Lower
		}
		

    y++;
    if (radiusError < 0)
      radiusError += (int16_t)(2 * y + 1);
    else{
      x--;
      radiusError += 2 * (((int16_t) y - (int16_t) x) + 1);
    }
  }
}

void lcd_character(uint8_t x, uint8_t y, uint8_t ch, uint16_t colorf, uint16_t colorb){
	// Bounds check
	if(ch > 127)
		return;

	lcd_window(x, y, 8, 8);
	
	
	
	uint8_t* bitmap = font8x8_basic[ch];
	for (int yi=0; yi < 8; ++yi) {
		for (int xi=0; xi < 8; ++xi)
			if(bitmap[yi] & (1 << xi)){
				lcd_transfer16(1, colorf);
				//lcd_data(colorf >> 8); // RGB565 Upper
				//lcd_data(colorf); // RGB565 Lower
			}else{
				lcd_transfer16(1, colorb);
				//lcd_data(colorb >> 8); // RGB565 Upper
				//lcd_data(colorb); // RGB565 Lower
			}
    }
}

uint8_t cursor_x;
uint8_t cursor_y;

void lcd_print_rgb(uint8_t* ch, uint16_t colorf, uint16_t colorb){
	unsigned int i = 0;
	uint8_t x_bound = cursor_x;
	
	while(ch[i] != '\0'){
		if(ch[i] == '\n'){
			cursor_y += 8;
			cursor_x = x_bound;
			i++;
			continue;
		}
		lcd_character(cursor_x, cursor_y, ch[i], colorf, colorb);
		i++;
		cursor_x += 8;
	}
}

void lcd_println_rgb(uint8_t* ch, uint16_t colorf, uint16_t colorb){
	uint8_t x_bound = cursor_x;
	lcd_print_rgb(ch, colorf, colorb);
	cursor_y += 8;
	cursor_x = x_bound;
}

void lcd_print(uint8_t* ch){
	lcd_print_rgb(ch, COLOR_WHITE, COLOR_BLACK);
}

void lcd_println(uint8_t* ch){
	lcd_println_rgb(ch, COLOR_WHITE, COLOR_BLACK);
}

void lcd_cursor(uint8_t x, uint8_t y){
	cursor_x = x;
	cursor_y = y;
}

void lcd_bitmap(uint8_t x, uint8_t y, uint16_t* bitmap, uint8_t width, uint8_t height){
	lcd_window(x, y, width, height);
	
	for(int i = 0; i < width*height; ++i){
		lcd_transfer16(1, bitmap[i]);
	}
}

void lcd_bitmap_alpha(uint8_t x, uint8_t y, uint16_t* bitmap, uint8_t width, uint8_t height, uint16_t alphacolor){
	for(int i = 0; i < width*height; ++i){
		if(bitmap[i] == alphacolor)
			continue;
		lcd_pixel(x + i%width, y + i/width, bitmap[i]);  
	}
}
